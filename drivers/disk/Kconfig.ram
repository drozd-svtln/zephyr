## drivers/disk/Kconfig.ram
```kconfig
# Copyright (c) 2016 Intel Corporation
# SPDX-License-Identifier: Apache-2.0

config DISK_DRIVER_RAM
	bool "RAM Disk"
	depends on DT_HAS_ZEPHYR_RAM_DISK_ENABLED
	default y
	help
	  RAM buffer used to emulate storage disk.
	  This option can be used to test the file
	  system.

if DISK_DRIVER_RAM

config DISK_RAM_DECOMPRESS
	bool "Decompress the initrd"
	depends on LZ4
	help
	  Decompress the initrd before using it as the RAM Disk.

module = RAMDISK
module-str = ramdisk
source "subsys/logging/Kconfig.template.log_config"

endif # DISK_DRIVER_RAM
```

## samples/drivers/firmware/scmi/boards/rpi_5.conf
```kconfig
# Copyright (c) 2026 EPAM Systems
# SPDX-License-Identifier: Apache-2.0

# CONFIG_ARM_SCMI_BASE_AGENT_HELPERS=y
# CONFIG_RESET=y

CONFIG_LOG=y
CONFIG_LOG_MODE_MINIMAL=y
CONFIG_PRINTK=y
CONFIG_SHELL=y

CONFIG_ARM_SCMI=y

CONFIG_CLOCK_CONTROL=y

CONFIG_PRINTK_SYNC=y
CONFIG_LOG_PRINTK=y
CONFIG_EARLY_CONSOLE=y
# CONFIG_EARLY_CONSOLE_BAUDRATE=115200
CONFIG_CONSOLE=y
# CONFIG_ARM_SCMI_BASE_EXT_REV=y
```
